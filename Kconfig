## Kconfig
```kconfig
config SIMPLE_BOOL
	bool "a root bool"

config SIMPLE_TRI
	tristate
	prompt "a root tri"

config SIMPLE_STR
	string "a root str"

config SIMPLE_HEX
	hex "a root hex"

config SIMPLE_INT
	int "a root int"
```
